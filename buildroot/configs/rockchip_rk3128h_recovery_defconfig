## buildroot/configs/rockchip_rk3128h_recovery_defconfig
```kconfig
#include "rk3128h_arm.config"
#include "base.config"
#include "base_extra.config"
#include "recovery.config"
BR2_ROOTFS_OVERLAY="board/rockchip/rk3128h/fs-overlay-recovery/"
```

## buildroot/configs/rockchip_rk3308_robot_recovery_defconfig
```kconfig
#include "rk3308_arm.config"
#include "recovery.config"
#  - use glibc as the basic libc
BR2_TOOLCHAIN_BUILDROOT_GLIBC=y
#  - Rockchip use 4.4 kernel, so we need 4.4 kernel header
BR2_KERNEL_HEADERS_4_4=y
#  - use local kernel source
BR2_LINUX_KERNEL_CUSTOM_GIT=y
BR2_LINUX_KERNEL_CUSTOM_REPO_URL="file://$(TOPDIR)/../kernel"
BR2_LINUX_KERNEL_CUSTOM_REPO_VERSION="HEAD"
#  - we use buildroot toolcharn here, may change to custom toolchain in the feature
BR2_TOOLCHAIN_BUILDROOT_CXX=y
#  - the post build script will be excuted after all fs-overlay copyed
BR2_ROOTFS_POST_BUILD_SCRIPT="build/post.sh"
#  - specify this is rockchip package
BR2_PACKAGE_ROCKCHIP=y
#  - show other busybox config
BR2_PACKAGE_BUSYBOX_SHOW_OTHERS=y
#  - we need to support various rootfs, cpio for ramdisk, ext2/4 for large system, squashfs for small system
BR2_TARGET_ROOTFS_CPIO=y
BR2_TARGET_ROOTFS_CPIO_GZIP=y
#  - some people may wish to use their own modified BusyBox configuration file.
BR2_PACKAGE_BUSYBOX_CONFIG="board/rockchip/common/base/busybox.config"
# extra base subset is the basic subset of all rootfs, ramdisk.
#  - we have to use eudev, because wayland need udev support
BR2_ROOTFS_DEVICE_CREATION_DYNAMIC_EUDEV=y
#  - vensor storage tool is used to r/w SN, wifi/bt/lan mac
BR2_PACKAGE_VENDOR_STORAGE=y
#  - usb device package used to init and config udc like adb and usb mass storage
BR2_PACKAGE_USBDEVICE=y
#  - we need adb as the basic tool
BR2_PACKAGE_ANDROID_TOOLS=y
BR2_PACKAGE_RKSCRIPT=y
BR2_PACKAGE_RECOVERY_NO_UI=y
```

## buildroot/configs/rockchip_rk356x_recovery_defconfig
```kconfig
#include "base.config"
#include "base_extra.config"
#include "recovery.config"
#include "rk356x_arm64.config"
BR2_ROOTFS_OVERLAY="board/rockchip/rk356x/fs-overlay-recovery/"
```

## buildroot/configs/rockchip_rv1108_cvr_defconfig
```kconfig
#include "rv1108_arm.config"
#include "rv1108_base.config"
#include "rv1108_cvr.config"
#include "rv1108_media.config"
BR2_PACKAGE_IO=y
BR2_PACKAGE_DOSFSTOOLS=y
BR2_PACKAGE_DOSFSTOOLS_FATLABEL=y
BR2_PACKAGE_DOSFSTOOLS_FSCK_FAT=y
BR2_PACKAGE_DOSFSTOOLS_MKFS_FAT=y
BR2_PACKAGE_PARTED=y
BR2_PACKAGE_ANDROID_TOOLS=y
```

## buildroot/configs/rockchip_rv1126_battery_ipc_4k_defconfig
```kconfig
#include "tinyrootfs.config"
#include "arm_a7.config"
#include "gcc8.config"
#include "camera.config"
BR2_CCACHE=y
BR2_TARGET_GENERIC_HOSTNAME="RV1126_RV1109"
BR2_TARGET_GENERIC_ISSUE="Welcome to Battery IPC"
BR2_TARGET_GENERIC_GETTY_PORT="ttyFIQ0"
BR2_TARGET_GENERIC_GETTY_BAUDRATE_1500000=y
BR2_ROOTFS_OVERLAY="board/rockchip/rv1126_rv1109/fs-overlay-battery-ipc"
BR2_ROOTFS_POST_BUILD_SCRIPT="board/rockchip/common/tinyrootfs/post-build-tinyrootfs.sh"
BR2_PACKAGE_RV1126_RV1109=y
BR2_PACKAGE_MPP_ALLOCATOR_DRM=y
BR2_PACKAGE_RKWIFIBT=y
BR2_PACKAGE_RKWIFIBT_AP6203BM=y
BR2_PACKAGE_RKMEDIA_V4L2_CAPTURE=y
BR2_PACKAGE_RKMEDIA_USE_AIQ=y
BR2_PACKAGE_RKMEDIA_MPP=y
# BR2_PACKAGE_RKMEDIA_MPP_DECODER is not set
BR2_PACKAGE_RKMEDIA_ALSA=y
BR2_PACKAGE_RKMEDIA_ALSA_PLAYBACK=y
BR2_PACKAGE_RKMEDIA_ALSA_CAPTURE=y
BR2_PACKAGE_RKMEDIA_AUDIO_ALGORITHM=y
BR2_PACKAGE_RKMEDIA_AUDIO_CODEC=y
BR2_PACKAGE_RKMEDIA_AUDIO_ENCODER=y
BR2_PACKAGE_RKMEDIA_RKRGA=y
BR2_PACKAGE_RKMEDIA_LIVE555=y
BR2_PACKAGE_RKMEDIA_RTSP_SERVER=y
BR2_PACKAGE_RKMEDIA_RTSP_SERVER_H264=y
# BR2_PACKAGE_MINIGUI_SOFTWARE_SCALE is not set
BR2_PACKAGE_MEDIASERVER=y
BR2_PACKAGE_MEDIASERVE_CONFIG="tb-4k_rtsp-link.conf"
# BR2_PACKAGE_MEDIASERVE_DBUS is not set
BR2_PACKAGE_MEDIASERVE_LINKAPI=y
# BR2_PACKAGE_MEDIASERVE_MINILOGGER is not set
BR2_PACKAGE_MEDIASERVE_TB=y
BR2_PACKAGE_RK_OEM=y
BR2_PACKAGE_RK_OEM_RESOURCE_DIR="$(TOPDIR)/../device/rockchip/oem/oem_battery_ipc"
BR2_PACKAGE_RK_OEM_IMAGE_FILESYSTEM_TYPE="squashfs"
BR2_PACKAGE_CAMERA_ENGINE_RKAIQ_IQFILE="imx415_YT10092_IR0147-36IRC-8M-F20.xml"
BR2_PACKAGE_CAMERA_ENGINE_RKAIQ_IQFILE_USE_BIN=y
BR2_PACKAGE_ISP2_IPC=y
BR2_PACKAGE_THUNDERBOOT=y
BR2_PACKAGE_THUNDERBOOT_BATIPC_LAUNCH=y
BR2_PACKAGE_THUNDERBOOT_CAMERA_FPS=15
BR2_THUNDERBOOT_INSTALL_MODULES="dw_mmc-rockchip.ko,snd-soc-es8311.ko,rk_sdmmc_ops.ko,sdmmc_vendor_storage.ko"
BR2_PACKAGE_FFMPEG_ENCODERS="pcm_alaw pcm_s16"
BR2_PACKAGE_FFMPEG_DECODERS="pcm_alaw pcm_s16"
BR2_PACKAGE_FFMPEG_MUXERS="mjpeg mp4"
BR2_PACKAGE_FFMPEG_DEMUXERS=""
BR2_PACKAGE_FFMPEG_PARSERS=""
BR2_PACKAGE_FFMPEG_BSFS=""
BR2_PACKAGE_FFMPEG_PROTOCOLS="file"
BR2_PACKAGE_FFMPEG_FILTERS=""
BR2_PACKAGE_E2FSPROGS=y
BR2_PACKAGE_E2FSPROGS_RESIZE2FS=y
# BR2_PACKAGE_ALSA_LIB_ALOAD is not set
# BR2_PACKAGE_ALSA_LIB_RAWMIDI is not set
# BR2_PACKAGE_ALSA_LIB_HWDEP is not set
# BR2_PACKAGE_ALSA_LIB_SEQ is not set
# BR2_PACKAGE_ALSA_LIB_ALISP is not set
# BR2_PACKAGE_ALSA_LIB_OLD_SYMBOLS is not set
BR2_PACKAGE_EXPAT=y
BR2_PACKAGE_JSON_C=y
BR2_PACKAGE_LIBGLIB2=y
# BR2_PACKAGE_IFUPDOWN_SCRIPTS is not set
BR2_PACKAGE_WPA_SUPPLICANT=y
BR2_PACKAGE_WPA_SUPPLICANT_EAP=y
```

## buildroot/configs/rockchip_rv1126_battery_ipc_nn_defconfig
```kconfig
#include "tinyrootfs.config"
#include "arm_a7.config"
#include "gcc8.config"
BR2_CCACHE=y
BR2_TARGET_GENERIC_HOSTNAME="RV1126_RV1109"
BR2_TARGET_GENERIC_ISSUE="Welcome to Battery IPC"
BR2_TARGET_GENERIC_GETTY_PORT="ttyFIQ0"
BR2_TARGET_GENERIC_GETTY_BAUDRATE_1500000=y
BR2_ROOTFS_OVERLAY="board/rockchip/rv1126_rv1109/fs-overlay-battery-ipc"
BR2_ROOTFS_POST_BUILD_SCRIPT="board/rockchip/common/tinyrootfs/post-build-tinyrootfs.sh"
BR2_PACKAGE_RV1126_RV1109=y
BR2_PACKAGE_MPP_ALLOCATOR_DRM=y
BR2_PACKAGE_RKWIFIBT=y
BR2_PACKAGE_RKWIFIBT_AP6203BM=y
BR2_PACKAGE_VENDOR_STORAGE=y
BR2_PACKAGE_RKMEDIA_V4L2_CAPTURE=y
BR2_PACKAGE_RKMEDIA_USE_AIQ=y
BR2_PACKAGE_RKMEDIA_MPP=y
# BR2_PACKAGE_RKMEDIA_MPP_DECODER is not set
BR2_PACKAGE_RKMEDIA_ALSA=y
BR2_PACKAGE_RKMEDIA_ALSA_PLAYBACK=y
BR2_PACKAGE_RKMEDIA_ALSA_CAPTURE=y
BR2_PACKAGE_RKMEDIA_AUDIO_ALGORITHM=y
BR2_PACKAGE_RKMEDIA_AUDIO_CODEC=y
BR2_PACKAGE_RKMEDIA_AUDIO_ENCODER=y
BR2_PACKAGE_RKMEDIA_RKRGA=y
BR2_PACKAGE_RKMEDIA_RKNN=y
BR2_PACKAGE_RKMEDIA_ROCKFACE=y
BR2_PACKAGE_RKMEDIA_LIVE555=y
BR2_PACKAGE_RKMEDIA_RTSP_SERVER=y
BR2_PACKAGE_RKMEDIA_RTSP_SERVER_H264=y
# BR2_PACKAGE_MINIGUI_SOFTWARE_SCALE is not set
BR2_PACKAGE_RKNPU_USE_MINI_DRIVER=y
# BR2_PACKAGE_ROCKFACE_FACE_RECOGNITION is not set
# BR2_PACKAGE_ROCKFACE_FACE_LANDMARK is not set
# BR2_PACKAGE_ROCKFACE_FACE_ATTRIBUTE is not set
# BR2_PACKAGE_ROCKFACE_OBJECT_DETECTION is not set
BR2_PACKAGE_MEDIASERVER=y
BR2_PACKAGE_MEDIASERVE_CONFIG="tb_nn_rtsp-link.conf"
# BR2_PACKAGE_MEDIASERVE_DBUS is not set
BR2_PACKAGE_MEDIASERVE_LINKAPI=y
BR2_PACKAGE_MEDIASERVE_LINKAPI_VENDOR=y
# BR2_PACKAGE_MEDIASERVE_MINILOGGER is not set
BR2_PACKAGE_MEDIASERVE_TB=y
BR2_PACKAGE_RK_OEM=y
BR2_PACKAGE_RK_OEM_RESOURCE_DIR="$(TOPDIR)/../device/rockchip/oem/oem_battery_ipc"
BR2_PACKAGE_RK_OEM_IMAGE_FILESYSTEM_TYPE="ext2"
BR2_PACKAGE_CAMERA_ENGINE_RKAIQ_IQFILE="sc210iot_YT-SC210-V2_M12-30IRC-2MP-F18.xml"
BR2_PACKAGE_CAMERA_ENGINE_RKAIQ_IQFILE_USE_BIN=y
BR2_PACKAGE_ISP2_IPC=y
BR2_PACKAGE_THUNDERBOOT=y
BR2_PACKAGE_THUNDERBOOT_BATIPC_LAUNCH=y
BR2_THUNDERBOOT_INSTALL_MODULES="dw_mmc-rockchip.ko,snd-soc-es8311.ko,rk_sdmmc_ops.ko,sdmmc_vendor_storage.ko"
BR2_PACKAGE_FFMPEG_ENCODERS="pcm_alaw pcm_s16"
BR2_PACKAGE_FFMPEG_DECODERS="pcm_alaw pcm_s16"
BR2_PACKAGE_FFMPEG_MUXERS=""
BR2_PACKAGE_FFMPEG_DEMUXERS=""
BR2_PACKAGE_FFMPEG_PARSERS=""
BR2_PACKAGE_FFMPEG_BSFS=""
BR2_PACKAGE_FFMPEG_PROTOCOLS=""
BR2_PACKAGE_FFMPEG_FILTERS=""
BR2_PACKAGE_E2FSPROGS=y
BR2_PACKAGE_E2FSPROGS_RESIZE2FS=y
# BR2_PACKAGE_ALSA_LIB_ALOAD is not set
# BR2_PACKAGE_ALSA_LIB_RAWMIDI is not set
# BR2_PACKAGE_ALSA_LIB_HWDEP is not set
# BR2_PACKAGE_ALSA_LIB_SEQ is not set
# BR2_PACKAGE_ALSA_LIB_ALISP is not set
# BR2_PACKAGE_ALSA_LIB_OLD_SYMBOLS is not set
BR2_PACKAGE_LIBV4L=y
BR2_PACKAGE_LIBV4L_UTILS=y
BR2_PACKAGE_EXPAT=y
BR2_PACKAGE_JSON_C=y
BR2_PACKAGE_LIBGLIB2=y
# BR2_PACKAGE_IFUPDOWN_SCRIPTS is not set
BR2_PACKAGE_WPA_SUPPLICANT=y
BR2_PACKAGE_WPA_SUPPLICANT_EAP=y
```

## buildroot/configs/rockchip_rv1126_rv1109_spi_nand_recovery_defconfig
```kconfig
#include "base.config"
#include "base_extra.config"
#include "rv1126_rv1109_arm.config"
#include "ubifs.config"
#include "recovery_updateEngine.config"
BR2_ROOTFS_OVERLAY="board/rockchip/rv1126_rv1109/fs-overlay-nand-recovery/"
```

## buildroot/configs/rockchip_rv1126_rv1109_tiny_defconfig
```kconfig
#include "arm_a7.config"
#include "gcc8.config"
#include "audio.config"
#include "video_mpp.config"
#include "camera.config"
BR2_TARGET_GENERIC_HOSTNAME="RV1126_RV1109"
BR2_TARGET_GENERIC_ISSUE="Welcome to RV1126_RV1109 Buildroot"
BR2_TARGET_GENERIC_GETTY_PORT="ttyFIQ0"
BR2_TARGET_GENERIC_GETTY_BAUDRATE_1500000=y
BR2_ROOTFS_OVERLAY="board/rockchip/rv1126_rv1109/fs-overlay-sysv-tiny"
BR2_PACKAGE_ROCKCHIP=y
BR2_PACKAGE_RV1126_RV1109=y
BR2_PACKAGE_CAMERA_ENGINE_RKAIQ_IQFILE="os04a10_CMK-OT1607-FV1_M12-40IRC-4MP-F16.xml"
BR2_PACKAGE_RKMEDIA_V4L2_CAPTURE=y
BR2_PACKAGE_RKMEDIA_USE_AIQ=y
BR2_PACKAGE_DRM_DISPLAY_OUTPUT=y
BR2_PACKAGE_RKMEDIA_MPP=y
BR2_PACKAGE_RKMEDIA_ALSA=y
BR2_PACKAGE_RKMEDIA_ALSA_PLAYBACK=y
BR2_PACKAGE_RKMEDIA_ALSA_CAPTURE=y
BR2_PACKAGE_RKMEDIA_AUDIO_ALGORITHM=y
BR2_PACKAGE_RKMEDIA_AUDIO_CODEC=y
BR2_PACKAGE_RKMEDIA_AUDIO_ENCODER=y
BR2_PACKAGE_RKMEDIA_AUDIO_DECODER=y
BR2_PACKAGE_RKMEDIA_RKRGA=y
BR2_PACKAGE_RKMEDIA_LIVE555=y
BR2_PACKAGE_RKMEDIA_RTSP_SERVER=y
BR2_PACKAGE_RKMEDIA_RTSP_SERVER_H264=y
BR2_PACKAGE_RKMEDIA_RTSP_SERVER_H265=y
# BR2_PACKAGE_MINIGUI_SOFTWARE_SCALE is not set
BR2_PACKAGE_LIBIPCPROTOCOL=y
BR2_PACKAGE_MEDIASERVER=y
BR2_PACKAGE_MEDIASERVE_OSD_SERVER=y
BR2_PACKAGE_MEDIASERVE_EXIV2_FEATURE=y
# BR2_PACKAGE_MEDIASERVE_USE_ROCKFACE is not set
# BR2_PACKAGE_MEDIASERVE_USE_ROCKX is not set
BR2_PACKAGE_RK_OEM=y
BR2_PACKAGE_RK_OEM_INSTALL_TARGET_DIR="$(BASE_DIR)/target/oem"
BR2_PACKAGE_RK_OEM_IMAGE_FILESYSTEM_TYPE="NONE"
BR2_PACKAGE_CALLFUNIPC=y
BR2_PACKAGE_ISP2_IPC=y
BR2_PACKAGE_ISP2_IPC_DBUS=y
BR2_PACKAGE_ISP2_IPC_MINILOGGER=y
# BR2_PACKAGE_ALSA_UTILS_ALSAMIXER is not set
# BR2_PACKAGE_FFMPEG_FFMPEG is not set
BR2_PACKAGE_FFMPEG_ENCODERS="mp2 adpcm_g726 pcm_alaw pcm_mulaw rawvideo mjpeg mpeg2video"
BR2_PACKAGE_FFMPEG_DECODERS="pcm_alaw pcm_mulaw rawvideo mjpeg mpeg2video"
BR2_PACKAGE_FFMPEG_MUXERS="pcm_alaw pcm_mulaw g722 g726 adts rawvideo mjpeg mp4 mov rtp flv f4v mpegts matroska avi rtsp mpeg1system"
BR2_PACKAGE_FFMPEG_DEMUXERS="pcm_alaw pcm_mulaw g722 g726 rawvideo mpegts mov flv matroska avi"
BR2_PACKAGE_FFMPEG_PARSERS=""
BR2_PACKAGE_FFMPEG_BSFS="aac_adtstoasc h264_metadata h264_mp4toannexb h264_redundant_pps hevc_metadata hevc_mp4toannexb dump_extradata remove_extradata"
BR2_PACKAGE_FFMPEG_PROTOCOLS="file rtp srtp rtmp rtmps http https"
BR2_PACKAGE_FFMPEG_FILTERS="scale"
# BR2_PACKAGE_FFMPEG_INDEVS is not set
# BR2_PACKAGE_FFMPEG_OUTDEVS is not set
BR2_PACKAGE_DBUS_GLIB=y
# BR2_PACKAGE_ALSA_LIB_ALOAD is not set
# BR2_PACKAGE_ALSA_LIB_SEQ is not set
# BR2_PACKAGE_ALSA_LIB_ALISP is not set
# BR2_PACKAGE_ALSA_LIB_OLD_SYMBOLS is not set
# BR2_PACKAGE_IFUPDOWN_SCRIPTS is not set
BR2_TARGET_ROOTFS_JFFS2=y
BR2_TARGET_ROOTFS_JFFS2_FLASH_64=y
BR2_TARGET_ROOTFS_SQUASHFS=y
BR2_TARGET_ROOTFS_SQUASHFS4_XZ=y
# BR2_TARGET_ROOTFS_TAR is not set
```

## buildroot/configs/rockchip_rv1126_rv1109_uvcc_defconfig
```kconfig
#include "base.config"
#include "debug.config"
#include "audio.config"
#include "video_mpp.config"
#include "rv1126_rv1109_arm.config"
#include "camera.config"
BR2_ROOTFS_OVERLAY="board/rockchip/rv1126_rv1109/fs-overlay-uvc/"
BR2_PACKAGE_GDB=y
BR2_PACKAGE_GDB_DEBUGGER=y
BR2_PACKAGE_SHM_TOOLS=y
BR2_PACKAGE_LIBIPCPROTOCOL=y
BR2_PACKAGE_RK_OEM=y
BR2_PACKAGE_RK_OEM_RESOURCE_DIR="$(TOPDIR)/../device/rockchip/oem/oem_uvcc"
BR2_PACKAGE_CAMERA_ENGINE_RKAIQ_IQFILE="os04a10_CMK-OT1607-FV1_M12-40IRC-4MP-F16.xml gc4c33_PCORW0009A_40IRC-4M.xml imx378_A12N01B_48IRC-12M-F18.xml"
BR2_PACKAGE_DBUS_GLIB=y
BR2_PACKAGE_UVC_APP=y
BR2_PACKAGE_RKNPU_NOT_RUN_RKNN_SERVER=y
BR2_PACKAGE_SMART_DISPLAY_SERVICE=y
BR2_PACKAGE_ROCKX=y
BR2_PACKAGE_CALLFUNIPC=y
BR2_PACKAGE_ISP2_IPC=y
BR2_PACKAGE_ISP2_IPC_DBUS=y
BR2_PACKAGE_ISP2_IPC_DBSERVER=y
BR2_PACKAGE_DBSERVER=y

#  - we have to use eudev, because need udev support
BR2_ROOTFS_DEVICE_CREATION_DYNAMIC_EUDEV=y
#  - we need to use fsck and resize2fs to check and extend ext2/4 file system when the first time system boot up
BR2_PACKAGE_E2FSPROGS=y
BR2_PACKAGE_E2FSPROGS_FSCK=y
BR2_PACKAGE_E2FSPROGS_RESIZE2FS=y
#  - usb device package used to init and config udc like adb and usb mass storage
BR2_PACKAGE_USBDEVICE=y
#  - we need adb as the basic tool
BR2_PACKAGE_ANDROID_TOOLS=y

# aiserver config
BR2_PACKAGE_AISERVER=y
BR2_PACKAGE_AISERVER_SHM_SERVER=y
BR2_PACKAGE_AISERVER_USE_ROCKX=y
BR2_PACKAGE_ROCKIT=y
BR2_PACKAGE_FFMPEG_ENCODERS=""
BR2_PACKAGE_FFMPEG_DECODERS=""
BR2_PACKAGE_FFMPEG_MUXERS=""
BR2_PACKAGE_FFMPEG_DEMUXERS=""
BR2_PACKAGE_FFMPEG_PARSERS=""
BR2_PACKAGE_FFMPEG_BSFS=""
BR2_PACKAGE_FFMPEG_PROTOCOLS=""
BR2_PACKAGE_FFMPEG_FILTERS=""
# uac config
BR2_PACKAGE_UAC_APP=y
```

## buildroot/configs/rockchip_rv1126_rv1109_uvcc_spi_nand_defconfig
```kconfig
#include "base.config"
#include "audio.config"
#include "video_mpp.config"
#include "rv1126_rv1109_arm.config"
#include "ubifs.config"
#include "camera.config"

#  - io tool used to read/write register and memory
BR2_PACKAGE_IO=y
# Provides things like kill, ps, uptime, free, top, etc for next generation
BR2_PACKAGE_PROCPS_NG=y

BR2_ROOTFS_OVERLAY="board/rockchip/rv1126_rv1109/fs-overlay-spi-nand-uvc/"
BR2_ROOTFS_POST_BUILD_SCRIPT="board/rockchip/rv1126_rv1109/pack-uvc-oem.sh"

#BR2_PACKAGE_GDB=y
#BR2_PACKAGE_GDB_DEBUGGER=y

BR2_PACKAGE_RKNPU_USE_MINI_DRIVER=y
BR2_PACKAGE_SHM_TOOLS=y
BR2_PACKAGE_LIBIPCPROTOCOL=y
BR2_PACKAGE_RK_OEM=y
BR2_PACKAGE_RK_OEM_RESOURCE_DIR="$(TOPDIR)/../device/rockchip/oem/oem_uvcc"
BR2_PACKAGE_CAMERA_ENGINE_RKAIQ_IQFILE="gc4c33_PCORW0009A_40IRC-4M.xml"
BR2_PACKAGE_DBUS_GLIB=y
BR2_PACKAGE_UVC_APP=y
BR2_PACKAGE_RKNPU_NOT_RUN_RKNN_SERVER=y
BR2_PACKAGE_SMART_DISPLAY_SERVICE=y
BR2_PACKAGE_ROCKX=y
BR2_PACKAGE_CALLFUNIPC=y
BR2_PACKAGE_ISP2_IPC=y
BR2_PACKAGE_ISP2_IPC_DBUS=y
BR2_PACKAGE_ISP2_IPC_DBSERVER=y
BR2_PACKAGE_DBSERVER=y

#  - we have to use eudev, because need udev support
#BR2_ROOTFS_DEVICE_CREATION_DYNAMIC_EUDEV=y
#  - we need to use fsck and resize2fs to check and extend ext2/4 file system when the first time system boot up
#BR2_PACKAGE_E2FSPROGS=y
#BR2_PACKAGE_E2FSPROGS_FSCK=y
#BR2_PACKAGE_E2FSPROGS_RESIZE2FS=y
#  - usb device package used to init and config udc like adb and usb mass storage
BR2_PACKAGE_USBDEVICE=y
#  - we need adb as the basic tool
BR2_PACKAGE_ANDROID_TOOLS=y

# aiserver config
BR2_PACKAGE_AISERVER=y
BR2_PACKAGE_AISERVER_SHM_SERVER=y
BR2_PACKAGE_AISERVER_USE_ROCKX=y
BR2_PACKAGE_ROCKIT=y
BR2_PACKAGE_FFMPEG_ENCODERS=""
BR2_PACKAGE_FFMPEG_DECODERS=""
BR2_PACKAGE_FFMPEG_MUXERS=""
BR2_PACKAGE_FFMPEG_DEMUXERS=""
BR2_PACKAGE_FFMPEG_PARSERS=""
BR2_PACKAGE_FFMPEG_BSFS=""
BR2_PACKAGE_FFMPEG_PROTOCOLS=""
BR2_PACKAGE_FFMPEG_FILTERS=""
# uac config
BR2_PACKAGE_UAC_APP=y

#A/B
BR2_PACKAGE_RECOVERY=y
BR2_PACKAGE_RECOVERY_BOOTCONTROL=y
BR2_PACKAGE_RECOVERY_USE_UPDATEENGINE=y
BR2_PACKAGE_RECOVERY_UPDATEENGINEBIN=y
```
