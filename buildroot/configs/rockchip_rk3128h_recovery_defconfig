## buildroot/package/chromium-wayland/Config.in
```kconfig
config BR2_PACKAGE_CHROMIUM_WAYLAND
	bool "chromium-ozone-wayland"
	depends on (BR2_arm && BR2_GCC_TARGET_FLOAT_ABI = "hard") || BR2_aarch64
	depends on BR2_PACKAGE_WAYLAND
	depends on BR2_TOOLCHAIN_GCC_AT_LEAST_9
	select BR2_PACKAGE_CAIRO
	select BR2_PACKAGE_DBUS
	select BR2_PACKAGE_EXPAT
	select BR2_PACKAGE_FFMPEG
	select BR2_PACKAGE_FLAC
	select BR2_PACKAGE_FREETYPE
	select BR2_PACKAGE_JPEG_TURBO
	select BR2_PACKAGE_LIBDRM
	select BR2_PACKAGE_LIBERATION
	select BR2_PACKAGE_LIBGLIB2
	select BR2_PACKAGE_LIBMALI
	select BR2_PACKAGE_LIBNSS
	select BR2_PACKAGE_LIBXKBCOMMON
	select BR2_PACKAGE_LIBXSLT
	select BR2_PACKAGE_LIBVPX
	select BR2_PACKAGE_OPUS
	select BR2_PACKAGE_PANGO
	select BR2_PACKAGE_WEBP
	select BR2_PACKAGE_WEBP_DEMUX
	select BR2_PACKAGE_WEBP_MUX
	select BR2_PACKAGE_AT_SPI2_ATK
	help
	  Chromium browser for wayland

	  Prebuilt from yocto's chromium-ozone-wayland:
	  https://github.com/JeffyCN/meta-rockchip/blob/master/dynamic-layers/recipes-browser/chromium/chromium-ozone-wayland_%25.bbappend
```

## buildroot/package/emulationstation/Config.in
```kconfig
# Emulation Station

source "package/emulationstation/batocera-emulationstation/Config.in"
source "package/emulationstation/batocera-es-system/Config.in"
source "package/emulationstation/es-background-musics/Config.in"
source "package/emulationstation/es-theme-carbon/Config.in"
source "package/emulationstation/emulationstation-fcamod/Config.in"
```

## buildroot/package/emulationstation/emulationstation-fcamod/Config.in
```kconfig
config BR2_PACKAGE_EMULATIONSTATION_FCAMOD
	bool "Emulationstation FCAMOD"
	depends on BR2_INSTALL_LIBSTDCPP
	depends on BR2_PACKAGE_ALSA_LIB
	depends on BR2_PACKAGE_ALSA_UTILS_AMIXER
	depends on BR2_PACKAGE_FFMPEG_ARCH_SUPPORTS # ffmpeg
	depends on (BR2_PACKAGE_HAS_LIBGLES || BR2_PACKAGE_HAS_LIBGL)
	select BR2_PACKAGE_SDL2
	select BR2_PACKAGE_SDL2_MIXER
	select BR2_PACKAGE_FFMPEG
	select BR2_PACKAGE_FFMPEG_AVRESAMPLE
	select BR2_PACKAGE_FFMPEG_SWSCALE
	select BR2_PACKAGE_LIBFREEIMAGE
	select BR2_PACKAGE_FREETYPE
	select BR2_PACKAGE_PULSEAUDIO
	select BR2_PACKAGE_DEJAVU
	select BR2_PACKAGE_OPENSSL
	select BR2_PACKAGE_LIBCURL
	select BR2_PACKAGE_LIBZIP
	select BR2_PACKAGE_XMLSTARLET
	help
	  A multi emulator frontend.

	  https://github.com/Aloshi/EmulationStation

if BR2_PACKAGE_EMULATIONSTATION_FCAMOD
choice
	prompt "ES version to compile"
config BR2_PACKAGE_EMULATIONSTATION_FCAMOD_STANDARD
	bool "standard"
config BR2_PACKAGE_EMULATIONSTATION_FCAMOD_ARCADE
	bool "arcade"
endchoice
endif

comment "Emulation station 2 needs a toolchain w/ C++, ALSA, Boost, GLES and SDL2"
	depends on !BR2_INSTALL_LIBSTDCPP || !BR2_PACKAGE_SDL2 || !BR2_PACKAGE_SDL2_MIXER || \
		!BR2_PACKAGE_ALSA_LIB || (!BR2_PACKAGE_HAS_LIBGLES || !BR2_PACKAGE_HAS_LIBGL)
```

## buildroot/package/emulators/Config.in
```kconfig
# Batocera Emulators

source "package/emulators/amiberry/Config.in"
source "package/emulators/cannonball/Config.in"
source "package/emulators/cemu/Config.in"
source "package/emulators/citra/Config.in"
source "package/emulators/daphne/Config.in"
source "package/emulators/devilutionx/Config.in"
source "package/emulators/dolphin-emu/Config.in"
source "package/emulators/duckstation/Config.in"
source "package/emulators/fsuae/Config.in"
source "package/emulators/hatari/Config.in"
source "package/emulators/linapple/Config.in"
source "package/emulators/mame/Config.in"
source "package/emulators/melonds/Config.in"
source "package/emulators/moonlight-embedded/Config.in"
source "package/emulators/mupen64plus/Config.in"
source "package/emulators/openbor/Config.in"
source "package/emulators/pcsx2/Config.in"
source "package/emulators/pcsx2_avx2/Config.in"
source "package/emulators/ppsspp/Config.in"
source "package/emulators/ppsspp15/Config.in"
source "package/emulators/python-pygame2/Config.in"
source "package/emulators/retroarch/Config.in"
source "package/emulators/rpcs3/Config.in"
source "package/emulators/scummvm/Config.in"
source "package/emulators/supermodel/Config.in"
source "package/emulators/vice/Config.in"
source "package/emulators/yuzu/Config.in"
```

## buildroot/package/emulators/advancemame/Config.in
```kconfig
config BR2_PACKAGE_ADVANCEMAME
	bool "advancemame"
	select BR2_PACKAGE_RPI_USERLAND if BR2_PACKAGE_RECALBOX_TARGET_RPI1 || BR2_PACKAGE_RECALBOX_TARGET_RPI2 || BR2_PACKAGE_RECALBOX_TARGET_RPI3
	select BR2_PACKAGE_RECALBOX_ROMFS_MAME
	help
	  A MAME 0.106-based emulator
	  http://www.advancemame.it
```

## buildroot/package/emulators/cemu/Config.in
```kconfig
# CEMU

source "package/emulators/cemu/cemu/Config.in"
source "package/emulators/cemu/cemu-hook/Config.in"
source "package/emulators/cemu/cemutil/Config.in"
```

## buildroot/package/emulators/openbor/Config.in
```kconfig
source "package/emulators/openbor/openbor4432/Config.in"
source "package/emulators/openbor/openbor6330/Config.in"
source "package/emulators/openbor/openbor6412/Config.in"
source "package/emulators/openbor/openbor6510/Config.in"
```

## buildroot/package/emulators/retroarch/Config.in
```kconfig
source "package/emulators/retroarch/batocera-bezel/Config.in"
source "package/emulators/retroarch/libretro/Config.in"
source "package/emulators/retroarch/retroarch/Config.in"
source "package/emulators/retroarch/retroarch-assets/Config.in"
source "package/emulators/retroarch/shaders/Config.in"
```

## buildroot/package/emulators/retroarch/libretro/Config.in
```kconfig
source "package/emulators/retroarch/libretro/libretro-81/Config.in"
source "package/emulators/retroarch/libretro/libretro-atari800/Config.in"
source "package/emulators/retroarch/libretro/libretro-beetle-lynx/Config.in"
source "package/emulators/retroarch/libretro/libretro-beetle-ngp/Config.in"
source "package/emulators/retroarch/libretro/libretro-beetle-pce/Config.in"
source "package/emulators/retroarch/libretro/libretro-beetle-pce-fast/Config.in"
source "package/emulators/retroarch/libretro/libretro-beetle-pcfx/Config.in"
source "package/emulators/retroarch/libretro/libretro-beetle-psx/Config.in"
source "package/emulators/retroarch/libretro/libretro-beetle-saturn/Config.in"
source "package/emulators/retroarch/libretro/libretro-beetle-supergrafx/Config.in"
source "package/emulators/retroarch/libretro/libretro-beetle-vb/Config.in"
source "package/emulators/retroarch/libretro/libretro-beetle-wswan/Config.in"
source "package/emulators/retroarch/libretro/libretro-blastem/Config.in"
source "package/emulators/retroarch/libretro/libretro-bluemsx/Config.in"
source "package/emulators/retroarch/libretro/libretro-bsnes/Config.in"
source "package/emulators/retroarch/libretro/libretro-cap32/Config.in"
source "package/emulators/retroarch/libretro/libretro-cheats/Config.in"
source "package/emulators/retroarch/libretro/libretro-citra/Config.in"
source "package/emulators/retroarch/libretro/libretro-desmume/Config.in"
source "package/emulators/retroarch/libretro/libretro-dosbox-pure/Config.in"
source "package/emulators/retroarch/libretro/libretro-fbneo/Config.in"
source "package/emulators/retroarch/libretro/libretro-fceumm/Config.in"
source "package/emulators/retroarch/libretro/libretro-flycast/Config.in"
source "package/emulators/retroarch/libretro/libretro-freeintv/Config.in"
source "package/emulators/retroarch/libretro/libretro-fuse/Config.in"
source "package/emulators/retroarch/libretro/libretro-gambatte/Config.in"
source "package/emulators/retroarch/libretro/libretro-genesisplusgx/Config.in"
source "package/emulators/retroarch/libretro/libretro-gpsp/Config.in"
source "package/emulators/retroarch/libretro/libretro-gw/Config.in"
source "package/emulators/retroarch/libretro/libretro-handy/Config.in"
source "package/emulators/retroarch/libretro/libretro-hatari/Config.in"
source "package/emulators/retroarch/libretro/libretro-imame/Config.in"
source "package/emulators/retroarch/libretro/libretro-kronos/Config.in"
source "package/emulators/retroarch/libretro/libretro-lutro/Config.in"
source "package/emulators/retroarch/libretro/libretro-mame/Config.in"
source "package/emulators/retroarch/libretro/libretro-mame2003-plus/Config.in"
source "package/emulators/retroarch/libretro/libretro-mame2010/Config.in"
source "package/emulators/retroarch/libretro/libretro-mgba/Config.in"
source "package/emulators/retroarch/libretro/libretro-mrboom/Config.in"
source "package/emulators/retroarch/libretro/libretro-mupen64plus-next/Config.in"
source "package/emulators/retroarch/libretro/libretro-neocd/Config.in"
source "package/emulators/retroarch/libretro/libretro-nestopia/Config.in"
source "package/emulators/retroarch/libretro/libretro-nxengine/Config.in"
source "package/emulators/retroarch/libretro/libretro-o2em/Config.in"
source "package/emulators/retroarch/libretro/libretro-opera/Config.in"
source "package/emulators/retroarch/libretro/libretro-parallel-n64/Config.in"
source "package/emulators/retroarch/libretro/libretro-pc88/Config.in"
source "package/emulators/retroarch/libretro/libretro-pc98/Config.in"
source "package/emulators/retroarch/libretro/libretro-pcsx/Config.in"
source "package/emulators/retroarch/libretro/libretro-picodrive/Config.in"
source "package/emulators/retroarch/libretro/libretro-pocketsnes/Config.in"
source "package/emulators/retroarch/libretro/libretro-pokemini/Config.in"
source "package/emulators/retroarch/libretro/libretro-ppsspp/Config.in"
source "package/emulators/retroarch/libretro/libretro-prboom/Config.in"
source "package/emulators/retroarch/libretro/libretro-prosystem/Config.in"
source "package/emulators/retroarch/libretro/libretro-puae/Config.in"
source "package/emulators/retroarch/libretro/libretro-px68k/Config.in"
source "package/emulators/retroarch/libretro/libretro-retro8/Config.in"
source "package/emulators/retroarch/libretro/libretro-scummvm/Config.in"
source "package/emulators/retroarch/libretro/libretro-snes9x/Config.in"
source "package/emulators/retroarch/libretro/libretro-snes9x-next/Config.in"
source "package/emulators/retroarch/libretro/libretro-stella/Config.in"
source "package/emulators/retroarch/libretro/libretro-tgbdual/Config.in"
source "package/emulators/retroarch/libretro/libretro-theodore/Config.in"
source "package/emulators/retroarch/libretro/libretro-tic80/Config.in"
source "package/emulators/retroarch/libretro/libretro-tyrquake/Config.in"
source "package/emulators/retroarch/libretro/libretro-vba-m/Config.in"
source "package/emulators/retroarch/libretro/libretro-vecx/Config.in"
source "package/emulators/retroarch/libretro/libretro-vice/Config.in"
source "package/emulators/retroarch/libretro/libretro-virtualjaguar/Config.in"
source "package/emulators/retroarch/libretro/libretro-yabasanshiro/Config.in"
```

## buildroot/package/emulators/retroarch/shaders/Config.in
```kconfig
source "package/emulators/retroarch/shaders/batocera-shaders/Config.in"
source "package/emulators/retroarch/shaders/common-shaders/Config.in"
source "package/emulators/retroarch/shaders/glsl-shaders/Config.in"
source "package/emulators/retroarch/shaders/slang-shaders/Config.in"
```

## buildroot/package/glibc/Config.in
```kconfig
if BR2_TOOLCHAIN_BUILDROOT_GLIBC

config BR2_PACKAGE_GLIBC
	bool
	default y
	select BR2_PACKAGE_LINUX_HEADERS
	select BR2_TOOLCHAIN_HAS_SSP if BR2_PACKAGE_HOST_BINUTILS_SUPPORTS_CFI
	help
	  https://www.gnu.org/software/libc/

if BR2_PACKAGE_GLIBC

config BR2_PACKAGE_GLIBC_GEN_LD_CACHE
	bool "glibc gen ld.so.cache"
	default y
	select BR2_PACKAGE_HOST_QEMU
	select BR2_PACKAGE_HOST_QEMU_LINUX_USER_MODE

config BR2_PACKAGE_GLIBC_2_22
	bool "glibc 2.22"
	default y if !BR2_TOOLCHAIN_HEADERS_AT_LEAST_3_2
	# No support for pthread barriers on < v9 ISA
	depends on !BR2_sparc

endif

endif
```

## buildroot/package/gstreamer1/gst1-rtsp-server-wfd/Config.in
```kconfig
config BR2_PACKAGE_GST1_RTSP_SERVER_WFD
	bool "gst1-rtsp-server-wfd"
    depends on !BR2_PACKAGE_GST1_RTSP_SERVER
	select BR2_PACKAGE_GST1_PLUGINS_BASE
	select BR2_PACKAGE_GST1_PLUGINS_BASE_PLUGIN_APP # runtime
	select BR2_PACKAGE_GST1_PLUGINS_GOOD
	select BR2_PACKAGE_GST1_PLUGINS_GOOD_PLUGIN_RTP # runtime
	select BR2_PACKAGE_GST1_PLUGINS_GOOD_PLUGIN_RTPMANAGER # runtime
	select BR2_PACKAGE_GST1_PLUGINS_GOOD_PLUGIN_UDP # runtime
	help
	  RTSP server library for wfd based on GStreamer.

	  https://github.com/albfan/gst-rtsp-server-wfd
```

## buildroot/package/libnghttp2/Config.in
```kconfig
config BR2_PACKAGE_LIBNGHTTP2
	bool "libnghttp2"
	help
	  libnghttp2 is a tool for getting files from FTP, HTTP, Gopher, Telnet,
	  and Dict servers, using any of the supported protocols.

	  http://nghttp2.org/
```

## buildroot/package/qt5/qt5canvas3d/Config.in
```kconfig
config BR2_PACKAGE_QT5CANVAS3D
	bool "qt5canvas3d"
	depends on BR2_PACKAGE_QT5_GL_AVAILABLE
	depends on BR2_PACKAGE_QT5_JSCORE_AVAILABLE
	depends on BR2_PACKAGE_QT5_VERSION_5_9 || BR2_PACKAGE_QT5_VERSION_5_12
	select BR2_PACKAGE_QT5DECLARATIVE
	select BR2_PACKAGE_QT5DECLARATIVE_QUICK
	help
	  Qt is a cross-platform application and UI framework for
	  developers using C++.

	  Qt Canvas 3D module provides a way to make WebGL-like
	  3D drawing calls from Qt Quick JavaScript.

	  http://doc.qt.io/qt-5/qtcanvas3d-index.html

comment "qt5canvas3d needs an OpenGL-capable backend"
	depends on !BR2_PACKAGE_QT5_GL_AVAILABLE
	depends on BR2_PACKAGE_QT5_JSCORE_AVAILABLE

comment "qt5canvas3d only available on 5.9/5.12"
	depends on !BR2_PACKAGE_QT5_VERSION_5_9 && !BR2_PACKAGE_QT5_VERSION_5_12
```

## buildroot/package/qt5/qt5coap/Config.in
```kconfig
config BR2_PACKAGE_QT5COAP
	bool "qt5coap"
	depends on BR2_PACKAGE_QT5_VERSION_5_15
	help
	  Qt is a cross-platform application and UI framework for
	  developers using C++.

	  CoAP is a protocol for IoT devices, and machine to machine
	  communication. The Qt CoAP module implements the client side
	  of CoAP defined by RFC 7252.

	  https://doc.qt.io/QtCoAP/qtcoap-index.html
```
