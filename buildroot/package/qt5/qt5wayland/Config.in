## buildroot/package/qt5/qt5wayland/Config.in
```kconfig
config BR2_PACKAGE_QT5WAYLAND
	bool "qt5wayland"
	select BR2_PACKAGE_WAYLAND
	help
	  Qt is a cross-platform application and UI framework for
	  developers using C++.

	  This package corresponds to the qt5wayland module.

	  http://qt.io

if BR2_PACKAGE_QT5WAYLAND

config BR2_PACKAGE_QT5WAYLAND_COMPOSITOR
	bool "Enable compositor (experimental)"
	help
	  The compositor API is still experimental, and not built by
	  default.

endif
```

## buildroot/package/rockchip/DuerClientSDK/Config.in
```kconfig
config BR2_PACKAGE_DUERCLIENTSDK
	bool "duer client sdk"
	help
	  DuerOS client sdk
```

## buildroot/package/rockchip/QLauncher/Config.in
```kconfig
config BR2_PACKAGE_QLAUNCHER
	bool "QLauncher"
	depends on BR2_PACKAGE_QT5
	select BR2_PACKAGE_HICOLOR_ICON_THEME
	help
	  Rockchip QLauncher application based on QT
```

## buildroot/package/rockchip/adbd/Config.in
```kconfig
config BR2_PACKAGE_ADBD
	bool "adbd porting for Linux"
	depends on BR2_PACKAGE_LIBCUTILS

comment "adbd needs libcutils"
	depends on !BR2_PACKAGE_LIBCUTILS
```

## buildroot/package/rockchip/alsa-config/Config.in
```kconfig
config BR2_PACKAGE_ALSA_CONFIG
	bool "alsa-config"
        depends on BR2_PACKAGE_ALSA_LIB
	help
	  "Copy extra alsa configs to /usr/share/alsa/"
```

## buildroot/package/rockchip/app_demo/Config.in
```kconfig
menuconfig BR2_PACKAGE_APP_DEMO
	bool "rk demos"

if BR2_PACKAGE_APP_DEMO

config BR2_PACKAGE_APP_DEMO_IMAGE_PROCESS
	bool "rk image process demo"
	select BR2_PACKAGE_GFLAGS
	select BR2_PACKAGE_LIBDRM
	select BR2_PACKAGE_LINUX_RGA
	select BR2_PACKAGE_SDL2
	select BR2_PACKAGE_SDL2_KMSDRM
	select BR2_PACKAGE_SDL2_OPENGLES
	select BR2_PACKAGE_SDL2_GFX
	select BR2_PACKAGE_SDL2_TTF
	depends on BR2_PACKAGE_FFMPEG
	depends on BR2_PACKAGE_FFMPEG_SWSCALE

comment "app_demo_image_process needs ffmpeg and ffmpeg_swscale"
	depends on !BR2_PACKAGE_FFMPEG
	depends on !BR2_PACKAGE_FFMPEG_SWSCALE

config BR2_PACKAGE_APP_DEMO_NPU_UVC_CONNECTION
	bool "rk npu uvc connection"
	select BR2_PACKAGE_LIBV4L
	select BR2_PACKAGE_RKMEDIA
	select BR2_PACKAGE_RKMEDIA_MPP
	select BR2_PACKAGE_RKMEDIA_MPP_DECODER
	select BR2_PACKAGE_RKMEDIA_V4L2_CAPTURE
	select BR2_PACKAGE_RKMEDIA_RKNN if BR2_PACKAGE_RK1808
	select BR2_PACKAGE_RKMEDIA_RKRGA if BR2_PACKAGE_RK1808
	select BR2_PACKAGE_CAMERA_ENGINE if BR2_PACKAGE_RK1808
	select BR2_PACKAGE_UVC_APP if BR2_PACKAGE_RK1808
	select BR2_PACKAGE_SDL2
	select BR2_PACKAGE_SDL2_KMSDRM if !BR2_PACKAGE_RK1808
	select BR2_PACKAGE_SDL2_OPENGLES if !BR2_PACKAGE_RK1808
	select BR2_PACKAGE_SDL2_GFX
	select BR2_PACKAGE_SDL2_TTF

config BR2_PACKAGE_APP_DEMO_RMSL
	bool "Rockchip Module Structured Light demo"
	select BR2_PACKAGE_CAMERA_ENGINE
	select BR2_PACKAGE_MPP
	select BR2_PACKAGE_LINUX_RGA

endif
```

## buildroot/package/rockchip/camera_engine_rkaiq/Config.in
```kconfig
menuconfig BR2_PACKAGE_CAMERA_ENGINE_RKAIQ
	depends on BR2_PACKAGE_CAMERA_ENGINE
	depends on BR2_ROCKCHIP_HAS_ISP2
	bool "Rockchip Camera Engine Rkaiq for SoC with ISP2"
	help
	  Rockchip camera engine rkaiq for linux.

if BR2_PACKAGE_CAMERA_ENGINE_RKAIQ

config BR2_PACKAGE_CAMERA_ENGINE_RKAIQ_IQFILE
	string "Rockchip Camera Engine IQ xml file"
	default ""
	help
	  Rockchip sensor IQ xml file.

config BR2_PACKAGE_CAMERA_ENGINE_RKAIQ_IQFILE_USE_BIN
	bool "Rockchip Camera Engine IQ xml file conver to bin"
	default n
	help
	  Rockchip sensor IQ bin file.

config BR2_PACKAGE_CAMERA_ENGINE_RKAIQ_FAKE_CAMERA_IQFILE
        string "Rockchip Camera Engine fake camera IQ xml file"
        default ""
        help
          Rockchip sensor fake camera IQ xml file.

config BR2_PACKAGE_CAMERA_ENGINE_RKAIQ_RKISP_DEMO
	bool "Build rkisp_demo"
	default n
	help
		Build rkisp_demo

endif
```

## buildroot/package/rockchip/ficial_gate/Config.in
```kconfig
config BR2_PACKAGE_FICIAL_GATE
    bool "ficial gate"
    select BR2_PACKAGE_RKFACIAL
    select BR2_PACKAGE_LIBDRM
    select BR2_PACKAGE_LINUX_RGA
    select BR2_PACKAGE_TSLIB
    select BR2_PACKAGE_LIBPNG12
    select BR2_PACKAGE_JPEG
    select BR2_PACKAGE_MINIGUI
    select BR2_PACKAGE_FREETYPE
```

## buildroot/package/rockchip/gst1-libav-rk/Config.in
```kconfig
config BR2_PACKAGE_GST1_LIBAV_RK
	bool "Gstreamer Rockchip ffmpeg plugins"
	select BR2_PACKAGE_GST1_PLUGINS_BASE
	select BR2_PACKAGE_LIBDRM
	help
	  Rockchip rkvdec video accel Gstreamer plugin.

	  This package contains GStreamer plugins base on
	  the libav project.

          https://github.com/JamesLinEngineer/gst-libav-rk

if BR2_PACKAGE_GST1_LIBAV_RK
config BR2_PACKAGE_GST1_LIBAV_RK_COLMV
	bool "Use 4K colmv separate config to save memory"

config BR2_PACKAGE_GST1_LIBAV_RK_DROP_ERROR
	bool "Drop error video frame no use to display"

config BR2_PACKAGE_GST1_LIBAV_RK_LOW_MEMORY
	bool "Low memory mode allow less memory to be allocated"

endif
```

## buildroot/package/rockchip/gstreamer1-rockchip-extra/Config.in
```kconfig
config BR2_PACKAGE_GSTREAMER1_ROCKCHIP_EXTRA
	bool "Gstreamer Rockchip extra plugins"
	select BR2_PACKAGE_GST1_PLUGINS_BASE
	select BR2_PACKAGE_LIBV4L
	help
	  GStreamer Rockchip offers graphics/camera for rockchip platform.

          https://github.com/rockchip-linux/gstreamer-rockchip-extra
```

## buildroot/package/rockchip/gstreamer1-rockchip/Config.in
```kconfig
config BR2_PACKAGE_GSTREAMER1_ROCKCHIP
	bool "Gstreamer Rockchip plugins"
	depends on BR2_PACKAGE_MPP
	select BR2_PACKAGE_GST1_PLUGINS_BASE
	help
	  GStreamer Rockchip offers the hardware accleration decoder/encoder
          for Rockchip Platform.

          https://github.com/rockchip-linux/gstreamer-rockchip
```

## buildroot/package/rockchip/ipcweb-backend/Config.in
```kconfig
config BR2_PACKAGE_IPCWEB_BACKEND
	bool "ipcweb backend for Linux"
	select BR2_PACKAGE_LIBCGICC
	select BR2_PACKAGE_OPENSSL
	select BR2_PACKAGE_LIBIPCPROTOCOL
	help
		ipcweb backend for Linux

if BR2_PACKAGE_IPCWEB_BACKEND

config BR2_PACKAGE_IPCWEB_BACKEND_JWT
        bool "jwt in ipcweb backend"
        default y
        help
                enable jwt in ipcweb backend

endif # BR2_PACKAGE_IPCWEB_BACKEND
```

## buildroot/package/rockchip/isp2-ipc/Config.in
```kconfig
menuconfig BR2_PACKAGE_ISP2_IPC
	bool "Rockchip ISP Server"
	help
	  Rockchip ISP server

if BR2_PACKAGE_ISP2_IPC

config BR2_PACKAGE_ISP2_IPC_DBUS
    bool "enable ispserver to use dbus communication"
    select BR2_PACKAGE_LIBGDBUS
    help
      Use dbus communication

config BR2_PACKAGE_ISP2_IPC_DBSERVER
    bool "enable ispserver to use dbserver"
    depends on BR2_PACKAGE_ISP2_IPC_DBUS
    select BR2_PACKAGE_LIBRKDB
    help
      Use database to save configuration

config BR2_PACKAGE_ISP2_IPC_MINILOGGER
    bool "enable ispserver miniloger print"
    select BR2_PACKAGE_MINILOGGER
    help
      Enable ispserver miniloger print.

endif # BR2_PACKAGE_ISP2_IPC
```

## buildroot/package/rockchip/libIPCProtocol/Config.in
```kconfig
menuconfig BR2_PACKAGE_LIBIPCPROTOCOL
	bool "rockchip libIPCProtocol"
	select BR2_PACKAGE_LIBGDBUS
	select BR2_PACKAGE_LIBRKDB
	select BR2_PACKAGE_DBUS_CPP
	help
	  rockchip libIPCProtocol

if BR2_PACKAGE_LIBIPCPROTOCOL

config BR2_PACKAGE_LIBIPCPROTOCOL_DEMO
	bool "rockchip libIPCProtocol demo"
	help
	  provide demo to show the usage of libIPCProtocol

endif
```

## buildroot/package/rockchip/libgdbus/Config.in
```kconfig
config BR2_PACKAGE_LIBGDBUS
	bool "libgdbus"
	select BR2_PACKAGE_LIBGLIB2
	select BR2_PACKAGE_DBUS
	help
	  libgdbus library
```

## buildroot/package/rockchip/libmali/Config.in
```kconfig
config BR2_PACKAGE_LIBMALI
	bool "rockchip libmali"
	depends on BR2_TOOLCHAIN_USES_GLIBC
	depends on BR2_aarch64 || (BR2_ARM_EABIHF && BR2_arm)
	select BR2_PACKAGE_LIBDRM
	select BR2_PACKAGE_HAS_LIBEGL if !BR2_PACKAGE_LIBMALI_ONLY_CL
	select BR2_PACKAGE_HAS_LIBGLES if !BR2_PACKAGE_LIBMALI_ONLY_CL
	select BR2_PACKAGE_HAS_LIBOPENCL if !BR2_PACKAGE_LIBMALI_WITHOUT_CL
	select BR2_PACKAGE_HAS_LIBEGL_WAYLAND if BR2_PACKAGE_LIBMALI_WAYLAND
	help
	  Install the binary user-space library for the ARM Mali GPU.
	  This package requires a kernel with the ARM Mali GPU Kernel
	  Drivers enabled.

if BR2_PACKAGE_LIBMALI

config BR2_PACKAGE_LIBMALI_WITHOUT_CL
	bool "without OpenCL"

choice
	prompt "display platform"
	default BR2_PACKAGE_LIBMALI_WAYLAND if BR2_PACKAGE_WAYLAND
	default BR2_PACKAGE_LIBMALI_X11 if BR2_PACKAGE_XORG7

config BR2_PACKAGE_LIBMALI_ONLY_CL
	bool "OpenCL only"
	depends on !BR2_PACKAGE_LIBMALI_WITHOUT_CL
	help
	  libmali for OpenCL only(no display platform).

config BR2_PACKAGE_LIBMALI_DUMMY
	bool "dummy"
	help
	  libmali for dummy platform.

config BR2_PACKAGE_LIBMALI_WAYLAND
	bool "wayland"
	depends on BR2_PACKAGE_WAYLAND
	help
	  libmali for wayland platform.

config BR2_PACKAGE_LIBMALI_X11
	bool "X11"
	depends on BR2_PACKAGE_XORG7
	select BR2_PACKAGE_LIBXCB
	select BR2_PACKAGE_XLIB_LIBX11
	help
	  libmali for X11 platform.

config BR2_PACKAGE_LIBMALI_GBM
	bool "GBM"
	help
	  libmali for GBM platform.

endchoice

config BR2_PACKAGE_PROVIDES_LIBEGL
	default "libmali" if !BR2_PACKAGE_LIBMALI_ONLY_CL

config BR2_PACKAGE_PROVIDES_LIBGLES
	default "libmali" if !BR2_PACKAGE_LIBMALI_ONLY_CL

# NOTE: utgard doesn't provide OpenCL
config BR2_PACKAGE_PROVIDES_LIBOPENCL
	default "libmali" if !BR2_PACKAGE_LIBMALI_WITHOUT_CL

endif
```

## buildroot/package/rockchip/libpng12/Config.in
```kconfig
config BR2_PACKAGE_LIBPNG12
	bool "libpng12"
	depends on !BR2_PACKAGE_LIBPNG
	select BR2_PACKAGE_ZLIB
	help
	  Library for handling PNG12 (Portable Network Graphics)
	  images, some library build need libpng 1.2 instead of
	  1.6. So need unselect BR2_PACKAGE_LIBPNG.

	  http://www.libpng.org/
```

## buildroot/package/rockchip/librkdb/Config.in
```kconfig
config BR2_PACKAGE_LIBRKDB
	bool "rockchip librkdb"
	select BR2_PACKAGE_LIBGLIB2
	select BR2_PACKAGE_SQLITE
	select BR2_PACKAGE_JSON_C
	help
	  rockchip database library
```

## buildroot/package/rockchip/linux-rga/Config.in
```kconfig
config BR2_PACKAGE_LINUX_RGA
	bool "Rockchip RGA lib for linux"
	select BR2_PACKAGE_LIBDRM
	help
	  Rockchip RGA lib for linux.
```

## buildroot/package/rockchip/minigui_desktop/Config.in
```kconfig
config BR2_PACKAGE_MINIGUI_DESKTOP
	bool "Minigui demo desktop"
	depends on BR2_PACKAGE_MINIGUI
	select BR2_PACKAGE_RTC_DEMO
	select BR2_PACKAGE_TSLIB
	select BR2_PACKAGE_LIBPNG12
	select BR2_PACKAGE_JPEG
	select BR2_PACKAGE_FREETYPE
	help
	  Minigui demo desktop

config BR2_PACKAGE_MINIGUI_RKKEYBOARD_EVENT
	string "RK KEY BOARD EVENT"
	default "event0"
	depends on BR2_PACKAGE_MINIGUI_DESKTOP
	help
		RK KEY BOARD EVENT
```

## buildroot/package/rockchip/modeset/Config.in
```kconfig
config BR2_PACKAGE_MODESET
	bool "modeset for Linux"
	depends on BR2_PACKAGE_LIBDRM
	select BR2_PACKAGE_JPEG
config BR2_PACKAGE_MODESET_SWAP_RB
	bool "swap rgb"
	depends on BR2_PACKAGE_MODESET
	default n
```

## buildroot/package/rockchip/mpp/Config.in
```kconfig
menuconfig BR2_PACKAGE_MPP
	bool "MPP(Multimedia Processing Platform)"
	select BR2_PACKAGE_LIBDRM

if BR2_PACKAGE_MPP
config BR2_PACKAGE_MPP_ALLOCATOR_DRM
	bool "Rockchip MPP use drm allocator"

config BR2_PACKAGE_MPP_TESTS
	bool "Install test programs"
	default n
	help
	  Install the test programs.
endif
```

## buildroot/package/rockchip/rkffplay/Config.in
```kconfig
menuconfig BR2_PACKAGE_RKFFPLAY
	bool "rkffplay"
	depends on BR2_PACKAGE_SDL2
	depends on BR2_PACKAGE_FFMPEG
```
