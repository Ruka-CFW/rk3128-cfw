## buildroot/package/rockchip/rkscript/Config.in
```kconfig
config BR2_PACKAGE_RKSCRIPT
	bool "rockchip script"
	help
	  rockchip script for linux use.

if BR2_PACKAGE_RKSCRIPT

config BR2_PACKAGE_RKSCRIPT_USE_BUSYBOX_MOUNT
	bool "use busybox mount"
	default y
	help
	  use busybox mount
endif

config BR2_PACKAGE_USB_MODULE
	bool "rockchip usb module"
	help
	  rockchip usb module support

config BR2_PACKAGE_USB_MODULE_NAME
	string "rockchip usb module name"
	default "phy-rockchip-inno-usb2.ko"
	depends on BR2_PACKAGE_USB_MODULE
	help
		rockchip usb module name
config BR2_PACKAGE_USB_USER_CONFIG
	bool "rockchip usb user config"
	depends on BR2_PACKAGE_RKSCRIPT
	help
	  rockchip usb user config

config BR2_PACKAGE_USB_USER_CONFIG_STRING
	string "usb config"
	depends on BR2_PACKAGE_USB_USER_CONFIG
	help
	  rockchip usb user config string,
	  use \n to combine two functions like usb_adb_en\nusb_ums_en

config BR2_PACKAGE_USB_MASS_STORAGE
	bool "rockchip usb mass storage"
	depends on BR2_PACKAGE_RKSCRIPT
	depends on !BR2_PACKAGE_USB_USER_CONFIG
	help
	  rockchip usb mass storage (ums)

config BR2_PACKAGE_USB_MASS_STORAGE_BLOCK
	string "rockchip usb mass storage block"
	default "/userdata/ums_shared.img"
	depends on BR2_PACKAGE_USB_MASS_STORAGE
	help
	  Fill a block or image file to shared with ums

config BR2_PACKAGE_USB_MASS_STORAGE_BLOCK_SIZE
	string "rockchip usb mass storage block SIZE (uint M)"
	default "8"
	depends on BR2_PACKAGE_USB_MASS_STORAGE
	help
	  ums shared block size, not worked with exsit file or block

config BR2_PACKAGE_USB_MASS_STORAGE_BLOCK_TYPE
	string "rockchip usb mass storage block TYPE"
	default "fat"
	depends on BR2_PACKAGE_USB_MASS_STORAGE
	help
	  ums shared block type, not worked with exsit file or block

config BR2_PACKAGE_USB_MASS_STORAGE_BLOCK_RO
	bool "rockchip usb mass storage block read-only"
	depends on BR2_PACKAGE_USB_MASS_STORAGE
	help
	  ums shared block is whether read-only

config BR2_PACKAGE_USB_MASS_STORAGE_BLOCK_AUTO_MOUNT
	bool "rockchip usb mass storage block auto mount"
	depends on BR2_PACKAGE_USB_MASS_STORAGE
	help
	  Enable ums shared block auto mount
	  mount when usb is disconnected, umount when usb is connected
	  Warning that umount ums shared block may be failed, because
	  usb is unabled to manage other applications which used ums
	  shared block when usb was going to umount block.

config BR2_PACKAGE_RKSCRIPT_DEFAULT_PCM
	string "default PCM"
	default "none"
	depends on BR2_PACKAGE_RKSCRIPT

	help
	  Change alsa default PCM to you selected
```

## buildroot/package/rockchip/rockit/Config.in
```kconfig
config BR2_PACKAGE_ROCKIT
    bool "rockit"
    select BR2_PACKAGE_MPP
    select BR2_PACKAGE_FFMPEG
    help
      rockit
```

## buildroot/package/rockchip/thunderboot/Config.in
```kconfig
menuconfig BR2_PACKAGE_THUNDERBOOT
	bool "rockchip thunderboot"
	depends on BR2_PACKAGE_RV1126_RV1109
	help
	  Rockchip tb(thunder boot) configuration.

if BR2_PACKAGE_THUNDERBOOT
config BR2_PACKAGE_THUNDERBOOT_BATIPC_LAUNCH
	bool "lunch for battery ipc"
	help
	  The default usage on battery ipc is special, that will power off
	  automatically if the cloud connection was not establish.

config BR2_PACKAGE_THUNDERBOOT_CAMERA_FPS
	int "camera fps setting"
	depends on BR2_PACKAGE_THUNDERBOOT_BATIPC_LAUNCH
	default 25
	help
	  Camera fps setting, default is 25fps.

config BR2_THUNDERBOOT_INSTALL_MODULES
	string "dirver modules"
	help
	  Kernel driver modules to be installed.

config BR2_THUNDERBOOT_ETH
	bool "ethernet configuration"
	help
	  Ethernet connection

config BR2_THUNDERBOOT_SIMPLIFY_USB
	bool "simplify usb configuration"
	help
	  Kernel driver modules to be installed.

if BR2_THUNDERBOOT_SIMPLIFY_USB

config BR2_THUNDERBOOT_USB_ADBD
	bool "rockchip thunderboot USB ADBD"
	select BR2_PACKAGE_ANDROID_TOOLS
	help
	  Use simplify ADB configuration.

config BR2_THUNDERBOOT_USB_RNDIS
	bool "rockchip thunderboot USB RNDIS"
	help
	  Use simplify RNDIS configuration.
	  Default net device is usb0.
	  Default net address is 190.168.1.100
endif
endif
```

## buildroot/package/rockchip/uvc_app/Config.in
```kconfig
config BR2_PACKAGE_UVC_APP
    bool "uvc app"
    select BR2_PACKAGE_LIBDRM
    select BR2_PACKAGE_MPP
    select BR2_PACKAGE_LIBV4L

if BR2_PACKAGE_UVC_APP
config BR2_PACKAGE_UVC_APP_MINILOGGER
	bool "enable uvc_app miniloger print"
	select BR2_PACKAGE_MINILOGGER
	default y
	help
	  Enable uvc_app miniloger print.
endif
```

## buildroot/package/usbmount/Config.in
```kconfig
config BR2_PACKAGE_USBMOUNT
	bool "usbmount"
	depends on BR2_PACKAGE_HAS_UDEV
	select BR2_PACKAGE_LOCKFILE_PROGS
	help
	  The usbmount package automatically mounts USB mass storage
	  devices when they are plugged in, and unmounts them when
	  they are removed.

	  http://usbmount.alioth.debian.org/

comment "usbmount requires udev to be enabled"
	depends on !BR2_PACKAGE_HAS_UDEV

config BR2_PACKAGE_USBMOUNT_SYNC
	bool "usbmount with sync option"
	depends on BR2_PACKAGE_USBMOUNT
	help
		mount usb storage with "sync" option
```
